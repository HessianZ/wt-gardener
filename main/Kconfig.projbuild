## main/Kconfig.projbuild
```kconfig
menu "WT-Gardener Config"


config ESPNOW_PMK
    string "ESPNOW primary master key"
    default "pmk1234567890123"
    help
        ESPNOW primary master for the example to use. The length of ESPNOW primary master must be 16 bytes.

config ESPNOW_LMK
    string "ESPNOW local master key"
    default "lmk1234567890123"
    help
        ESPNOW local master for the example to use. The length of ESPNOW local master must be 16 bytes.

config ESPNOW_CHANNEL
    int "Channel"
    default 1
    range 1 13
    help
        The channel on which sending and receiving ESPNOW data.

config GARDENER_SLEEP_DURATION
    int "Sleep duration"
    default 300
    help
        The duration in seconds for which the device will sleep between measurements.

config GARDENER_TEMPERATURE_ENABLED
    bool "Temperature sensor"
    default y
    help
        Enable Temperature sensor(AHT10)

config GARDENER_ILLUMINATE_ENABLED
    bool "Illuminate sensor"
    default y
    help
        Enable illuminate sensor(BH1750)

config GARDENER_EARTHHUMI_ENABLED
    bool "Earth humidity sensor"
    default y
    help
        Enable Earth humidity sensor(ADC based)


endmenu
```
